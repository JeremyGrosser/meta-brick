## conf/distro/brick.conf
```bitbake
require conf/distro/include/security_flags.inc

DISTRO = "brick"
DISTRO_NAME = "brick"
DISTRO_VERSION = "2.5"
DISTRO_CODENAME = "thud"
SDK_VENDOR = "-bricksdk"
TARGET_VENDOR = "-brick"

BRICK_DISTRO_FEATURES ?= "systemd"
DISTRO_FEATURES ?= "${DISTRO_FEATURES_DEFAULT} ${DISTRO_FEATURES_LIBC} ${BRICK_DISTRO_FEATURES}"
DISTRO_FEATURES_remove = "3g"

DISTRO_FEATURES_BACKFILL_CONSIDERED += " sysvinit"
VIRTUAL-RUNTIME_init_manager = "systemd"
VIRTUAL-RUNTIME_initscripts = ""
VIRTUAL-RUNTIME_dev_manager = "udev"

KERNEL_FEATURES += " features/usb/usb-gadgets.scc"
KERNEL_MODULE_AUTOLOAD += " g_ether"
KERNEL_MODULE_PROBECONF += " g_ether"
#module_conf_g_ether = "options g_ether "
DISTRO_EXTRA_RDEPENDS += " kernel-module-g-ether"
```

## conf/layer.conf
```bitbake
# We have a conf and classes directory, add to BBPATH
BBPATH .= ":${LAYERDIR}"

# We have recipes-* directories, add to BBFILES
BBFILES += "${LAYERDIR}/recipes-*/*/*.bb \
            ${LAYERDIR}/recipes-*/*/*.bbappend"

BBFILE_COLLECTIONS += "meta-brick"
BBFILE_PATTERN_meta-brick = "^${LAYERDIR}/"
BBFILE_PRIORITY_meta-brick = "6"
LAYERSERIES_COMPAT_meta-brick = "sumo"
```
